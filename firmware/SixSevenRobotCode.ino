// Single-model sketch (Edge Impulse merged model)
// Make sure you've added the single merged Edge Impulse Arduino library ZIP
// (Sketch -> Include Library -> Add .ZIP Library) before compiling.
// Include the Edge Impulse model header generated by the merged project:
#include <Voice_Six_Seven_inferencing.h> // replace with the actual header name from your merged export

#include <driver/i2s.h>

// ----- I2S (INMP441) pins -----
#define I2S_WS   15   // LRCLK / WS
#define I2S_SD   32   // Data out (DOUT)
#define I2S_SCK  14   // BCLK

// ----- Motor (L298N) pins -----
const int ENA = 25;   // PWM
const int IN1 = 26;   // dir
const int IN2 = 27;   // dir

// motor helper
void moveForward(uint8_t speed) {
  digitalWrite(IN1, HIGH);
  digitalWrite(IN2, LOW);
  ledcWrite(ENA, speed); // use LEDC PWM channel 0
}
void stopMotor() {
  digitalWrite(IN1, LOW);
  digitalWrite(IN2, LOW);
  ledcWrite(ENA, 0);
}

// shared audio buffer size from model metadata (provided by merged lib)
static const size_t dsp_input_frame_size = EI_CLASSIFIER_DSP_INPUT_FRAME_SIZE;
static const size_t raw_sample_count = EI_CLASSIFIER_RAW_SAMPLE_COUNT; // total number of raw samples expected

// Circular buffer to collect raw int16 samples from I2S.
// We'll record 'raw_sample_count' samples before invoking classifier.
static int16_t audio_buffer[EI_CLASSIFIER_RAW_SAMPLE_COUNT];

// I2S read helper: read exactly raw_sample_count int16 samples into audio_buffer
bool read_audio_i2s() {
  size_t bytes_to_read = raw_sample_count * sizeof(int16_t);
  size_t bytes_read = 0;
  char *bufptr = (char*)audio_buffer;

  // The I2S peripheral returns 16-bit samples, mono (left-only)
  while (bytes_read < bytes_to_read) {
    size_t to_read = bytes_to_read - bytes_read;
    size_t r = 0;
    esp_err_t err = i2s_read(I2S_NUM_0, bufptr + bytes_read, to_read, &r, portMAX_DELAY);
    if (err != ESP_OK) return false;
    bytes_read += r;
  }
  return true;
}

// convert function that Edge Impulse expects
static int audio_signal_get_data(size_t offset, size_t length, float *out_ptr) {
  // convert int16 -> float in range [-1.0, 1.0]
  for (size_t i = 0; i < length; i++) {
    out_ptr[i] = (float)audio_buffer[offset + i] / 32768.0f;
  }
  return 0;
}

// I2S initialization for INMP441
void i2s_init() {
  const i2s_config_t i2s_config = {
    .mode = (i2s_mode_t)(I2S_MODE_MASTER | I2S_MODE_RX),
    .sample_rate = EI_CLASSIFIER_FREQUENCY, // should be 16000 from your model
    .bits_per_sample = I2S_BITS_PER_SAMPLE_16BIT,
    .channel_format = I2S_CHANNEL_FMT_ONLY_LEFT,
    .communication_format = I2S_COMM_FORMAT_STAND_I2S,
    .intr_alloc_flags = ESP_INTR_FLAG_LEVEL1,
    .dma_buf_count = 4,
    .dma_buf_len = 512,
    .use_apll = false,
    .tx_desc_auto_clear = false,
    .fixed_mclk = 0
  };

  const i2s_pin_config_t pin_config = {
    .bck_io_num = I2S_SCK,
    .ws_io_num = I2S_WS,
    .data_out_num = -1,
    .data_in_num = I2S_SD
  };

  i2s_driver_install(I2S_NUM_0, &i2s_config, 0, NULL);
  i2s_set_pin(I2S_NUM_0, &pin_config);
}

// state
bool heardSix = false;

void setup() {

  pinMode(IN1, OUTPUT);
  pinMode(IN2, OUTPUT);
  ledcAttachChannel(ENA, 30000, 8, 0);

  stopMotor();

  i2s_init();

  Serial.begin(115200);
  Serial.println("Ready — listening for 'six' then 'seven'");
}

void loop() {
  // 1) read audio samples (blocking until raw_sample_count collected)
  if (!read_audio_i2s()) {
    Serial.println("I2S read error");
    delay(200);
    return;
  }

  // 2) setup Edge Impulse signal
  signal_t signal;
  signal.total_length = raw_sample_count;
  signal.get_data = &audio_signal_get_data;

  ei_impulse_result_t result;
  bool debug_nn = false;

  // 3) run classifier
  EI_IMPULSE_ERROR r = run_classifier(&signal, &result, debug_nn);
  if (r != EI_IMPULSE_OK) {
    Serial.printf("ERR: classifier returned %d\n", r);
    delay(200);
    return;
  }

  // 4) print results
  Serial.printf("Classification (dsp: %d ms, cls: %d ms, anomaly: %d ms)\n",
                result.timing.dsp, result.timing.classification, result.timing.anomaly);
  for (size_t i = 0; i < EI_CLASSIFIER_LABEL_COUNT; i++) {
    Serial.printf(" %s: %.5f\n", result.classification[i].label, result.classification[i].value);
  }

  // 5) detection logic (tweak thresholds to your model)
  // Find the top label and confidence
  float best_conf = 0.0f;
  String best_label = "";
  for (size_t i = 0; i < EI_CLASSIFIER_LABEL_COUNT; i++) {
    if (result.classification[i].value > best_conf) {
      best_conf = result.classification[i].value;
      best_label = String(result.classification[i].label);
    }
  }

  // threshold (tune as necessary)
  const float DETECT_THRESHOLD = 0.6f;

  if (best_conf >= DETECT_THRESHOLD) {
    if (best_label == "six") {
      Serial.println("Detected: SIX");
      heardSix = true;
    } else if (best_label == "seven") {
      Serial.println("Detected: SEVEN");
      if (heardSix) {
        Serial.println("SIX then SEVEN detected -> trigger motor");
        moveForward(200); // speed 0-255 (8-bit)
        delay(1200);
        stopMotor();
        heardSix = false;
      } else {
        // heard seven but not six before
      }
    } else {
      // noise or other label
    }
  } else {
    // below threshold: treat as noise
  }

  // small pause (adjust if desired)
  delay(100);
}
